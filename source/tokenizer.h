// GPT-2 style byte-level BPE tokenizer for MiniMind (vocab 6400).
// Data (tk_str / tk_m_* / tk_special_*) is generated by tools/convert_minimind.py
// into include/tokenizer_data.h. The byte-level mapping matches HF's tokenizer.json
// exactly, so decode is lossless. Encode uses global greedy BPE over the
// byte-level symbol stream (a faithful, slightly simplified version of the
// GPT-2 pretokenizer; good enough for a chat demo).
#ifndef TOKENIZER_H
#define TOKENIZER_H
#include <stdint.h>
#include <string.h>
#include <stdlib.h>

#include "tokenizer_data.h"

// On ESP32 the hash tables (~280KB) live in PSRAM, not internal .bss.
#ifdef ESP_PLATFORM
#include "esp_heap_caps.h"
#define TOK_ALLOC(n) heap_caps_malloc((n), MALLOC_CAP_SPIRAM)
#else
#define TOK_ALLOC(n) malloc(n)
#endif

// ---- GPT-2 bytes_to_unicode table (codepoint per byte) ----------------------
// 重要: 这里只能 extern 声明! 真正的定义在 YuanDiArduino.ino 里 (单一 TU)
// 原因: 头文件被多个 .cpp include (.ino + web_chat.cpp) 时, 如果放非 extern 的
// 定义, 链接器报 multiple definition; 如果放 static, 每个 TU 拿到独立副本
// (tok_init 只填 .ino 那份, web_chat.cpp 用的是全零的, BPE 全输出 token 0)
extern int tok_bu[256];                 // byte -> unicode codepoint
extern int tok_byte_to_id[256];
extern char **tok_bl;                   // per-id byte-level repr (arena-backed)

#define TOK_HCAP 16384
extern const char **tok_bl_key;         // djb2 string hash -> id
extern int         *tok_bl_val;
#define TOK_MCAP 16384
extern uint32_t *tok_m_key;             // (a<<16)|b -> (rank<<16)|newid
extern uint32_t *tok_m_val;

static uint32_t tok_strhash(const char *s) {
  uint32_t h = 5381;
  while (*s) h = ((h << 5) + h) ^ (uint8_t)*s++;
  return h;
}
static int tok_bl_lookup(const char *s) {
  uint32_t i = tok_strhash(s) & (TOK_HCAP - 1);
  while (tok_bl_key[i]) {
    if (strcmp(tok_bl_key[i], s) == 0) return tok_bl_val[i];
    i = (i + 1) & (TOK_HCAP - 1);
  }
  return -1;
}
static void tok_bl_insert(const char *key, int val) {
  uint32_t i = tok_strhash(key) & (TOK_HCAP - 1);
  while (tok_bl_key[i]) i = (i + 1) & (TOK_HCAP - 1);
  tok_bl_key[i] = key; tok_bl_val[i] = val;
}
static uint32_t tok_merge_lookup(uint32_t k) {
  if (!tok_m_key || !tok_m_val) return 0xFFFFFFFFu;  // 防御: tok_init 失败时 NULL
  uint32_t i = (k * 2654435761u) & (TOK_MCAP - 1);
  while (tok_m_key[i]) {
    if (tok_m_key[i] == k) return tok_m_val[i];
    i = (i + 1) & (TOK_MCAP - 1);
  }
  return 0xFFFFFFFFu;
}

static int tok_is_special(int id);

// UTF-8 encode a codepoint into out (>=3 bytes). Returns length.
static int tok_utf8(int cp, char *out) {
  if (cp < 0x80) { out[0] = (char)cp; return 1; }
  if (cp < 0x800) {
    out[0] = (char)(0xC0 | (cp >> 6));
    out[1] = (char)(0x80 | (cp & 0x3F));
    return 2;
  }
  out[0] = (char)(0xE0 | (cp >> 12));
  out[1] = (char)(0x80 | ((cp >> 6) & 0x3F));
  out[2] = (char)(0x80 | (cp & 0x3F));
  return 3;
}

static void tok_init(void) {
  // heap-allocate the big tables (PSRAM on ESP32)
  tok_bl     = (char **)TOK_ALLOC(sizeof(char *) * TOK_VOCAB);
  tok_bl_key = (const char **)TOK_ALLOC(sizeof(char *) * TOK_HCAP);
  tok_bl_val = (int *)TOK_ALLOC(sizeof(int) * TOK_HCAP);
  tok_m_key  = (uint32_t *)TOK_ALLOC(sizeof(uint32_t) * TOK_MCAP);
  tok_m_val  = (uint32_t *)TOK_ALLOC(sizeof(uint32_t) * TOK_MCAP);
  // single arena for all byte-level strings (each byte expands to <=2 UTF-8
  // bytes of its bytes_to_unicode codepoint... max 3, so *3+1 is safe)
  size_t arena_sz = 0;
  for (int id = 0; id < TOK_VOCAB; id++) arena_sz += strlen(tk_str[id]) * 3 + 1;
  char *arena = (char *)TOK_ALLOC(arena_sz);
  if (!tok_bl || !tok_bl_key || !tok_bl_val || !tok_m_key || !tok_m_val || !arena)
    return;  // allocation failure: caller's model-load checks will surface it
  // build bytes_to_unicode
  int printable[256]; for (int i = 0; i < 256; i++) printable[i] = 0;
  for (int b = 33; b <= 126; b++) printable[b] = 1;
  for (int b = 161; b <= 172; b++) printable[b] = 1;
  for (int b = 174; b <= 255; b++) printable[b] = 1;
  int n = 0;
  for (int b = 0; b < 256; b++) {
    if (printable[b]) tok_bu[b] = b;
    else { tok_bu[b] = 256 + n; n++; }
  }
  // per-id byte-level repr + hash (skip specials in BPE space)
  for (int i = 0; i < TOK_HCAP; i++) { tok_bl_key[i] = 0; tok_bl_val[i] = -1; }
  for (int i = 0; i < TOK_MCAP; i++) tok_m_key[i] = 0;
  char tmp[8];
  char *ap = arena;
  for (int id = 0; id < TOK_VOCAB; id++) {
    const char *s = tk_str[id];
    int len = 0;
    char *buf = ap;
    for (int j = 0; s[j]; j++) {
      int L = tok_utf8(tok_bu[(unsigned char)s[j]], tmp);
      memcpy(buf + len, tmp, L); len += L;
    }
    buf[len] = 0;
    ap += len + 1;
    tok_bl[id] = buf;
    if (tok_is_special(id)) continue;          // specials are not merged
    tok_bl_insert(buf, id);
  }
  // base byte -> id
  for (int b = 0; b < 256; b++) {
    int L = tok_utf8(tok_bu[b], tmp);
    tmp[L] = 0;
    int id = tok_bl_lookup(tmp);
    tok_byte_to_id[b] = (id < 0) ? 0 : id;
  }
  // merge hash (keep first = lowest rank, since list is rank-ordered)
  for (int m = 0; m < TOK_NMERGE; m++) {
    uint32_t k = ((uint32_t)tk_m_l[m] << 16) | (uint32_t)tk_m_r[m];
    uint32_t v = ((uint32_t)m << 16) | (uint32_t)tk_m_new[m];
    uint32_t i = (k * 2654435761u) & (TOK_MCAP - 1);
    while (tok_m_key[i]) i = (i + 1) & (TOK_MCAP - 1);
    tok_m_key[i] = k; tok_m_val[i] = v;
  }
  // 诊断: 看看 tok_init 是不是真成功了
  Serial.printf("[tok_init] bl=%p key=%p m_key=%p arena=%p\n",
    (void*)tok_bl, (void*)tok_bl_key, (void*)tok_m_key, (void*)arena);
}

static int tok_is_special(int id) {
  for (int i = 0; i < TOK_NSPECIAL; i++)
    if (tk_special_id[i] == id) return 1;
  return 0;
}

// GPT-2 / MiniMind BPE encoder.
// 1) Scan for the EARLIEST registered special token (e.g. <|im_start|>) in the
//    remaining text. Anything before it is BPE'd as normal text; the special
//    string itself becomes one symbol.
// 2) BPE: start from 1-byte symbols and greedily merge the lowest-rank adjacent
//    pair (per the merge table) until no merge applies.
static int tok_encode(const char *text, int *out, int max_out) {
  int n = 0;
  int len = (int)strlen(text);
  int i = 0;
  while (i < len) {
    // find the EARLIEST special token anywhere in the remaining text
    int found_pos = -1, found_si = -1, found_len = 0;
    for (int p = i; p < len; p++) {
      int matched = 0;
      for (int si = 0; si < TOK_NSPECIAL; si++) {
        const char *sp = tk_special_str[si];
        int sl = (int)strlen(sp);
        if (p + sl <= len && strncmp(text + p, sp, sl) == 0) {
          found_pos = p; found_si = si; found_len = sl; matched = 1; break;
        }
      }
      if (matched) break;
    }
    int seg_end = (found_pos >= 0) ? found_pos : len;
    // BPE over text[i .. seg_end). `sym` is kept static: a 4096-int buffer is
    // 16 KB, far too large for the Arduino loop task's default 8 KB stack.
    // tok_encode is only ever called single-threaded, so a static buffer is safe.
    if (seg_end > i) {
      static int sym[4096]; int nsym = 0;
      for (int j = i; j < seg_end && nsym < 4096; j++)
        sym[nsym++] = tok_byte_to_id[(uint8_t)text[j]];
      for (;;) {
        int best_rank = 0x7FFFFFFF, best_pos = -1, best_new = 0;
        for (int p = 0; p + 1 < nsym; p++) {
          uint32_t k = ((uint32_t)sym[p] << 16) | (uint32_t)sym[p + 1];
          uint32_t v = tok_merge_lookup(k);
          if (v != 0xFFFFFFFFu) {
            int rank = (int)(v >> 16);
            if (rank < best_rank) { best_rank = rank; best_pos = p; best_new = (int)(v & 0xFFFF); }
          }
        }
        if (best_pos < 0) break;
        sym[best_pos] = best_new;
        for (int p = best_pos + 1; p + 1 < nsym; p++) sym[p] = sym[p + 1];
        nsym--;
      }
      for (int p = 0; p < nsym && n < max_out; p++) out[n++] = sym[p];
    }
    if (found_si >= 0) {
      if (n < max_out) out[n++] = tk_special_id[found_si];
      i = found_pos + found_len;
    } else break;
  }
  return n;
}

// Decode a single token id to raw UTF-8 bytes (already real bytes). Returns len.
static int tok_decode_token(int id, char *out) {
  if (id < 0 || id >= TOK_VOCAB) { out[0] = 0; return 0; }
  const char *s = tk_str[id];
  int L = (int)strlen(s);
  memcpy(out, s, L); out[L] = 0;
  return L;
}

#endif
